VERSION ""

NS_ :

BS_:

BU_: ECU2_Speed ECU1_ACC_CMD

BO_ 939 Speed_Val_Message: 1 ECU2_Speed
 SG_ Speed : 0|8@1+ (1,0) [0|255] ""  ECU1_ACC_CMD

BO_ 48 ACC_CMD_Message: 1 ECU1_ACC_CMD
 SG_ ACC_ON_OFF : 0|8@1+ (1,0) [0|1] ""  ECU2_Speed
