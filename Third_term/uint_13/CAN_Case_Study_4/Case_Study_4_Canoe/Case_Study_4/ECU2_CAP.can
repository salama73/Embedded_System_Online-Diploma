/*@!Encoding:65001*/
includes
{
  
}

variables
{
 int speed=0;
  message Speed_Val_Message Speed_Val;
}

on start
{
   write("****************ECU2 Start***************");
}

on message ACC_CMD_Message
{
  if(this.ACC_ON_OFF.phys == 1)
  {
    if(speed==255)
      speed=255;
    else
      speed++;
  }
  else
  {
    if(speed==0)
      speed=0;
    else
      speed--;
  }
  Speed_Val.Speed.phys=speed;
  output(Speed_Val);
}
